## collector/main/Kconfig.projbuild
```kconfig
menu "Collector Configuration"
  config LEN_FILE_LIST
    int "File List Length"
    default 8
    range 1 16
    help
    Maximum number of files to transfer in one window
  config LEN_PEER_QUEUE
    int "Maximum peer queue length"
    default 8
    range 1 16
    help
    Maximum number of queue containing peers who respond to the sync packet
  config WRITE_BUF_SIZE
    int "File Write Buffer Size"
    default 8192
    range 1024 32768
    help
    File write buffer size
  config ALWAYS_DOWNLOAD
    bool "Always redownload data even if already downloaded"
    help
        Probably only useful when testing throughput
endmenu
```

## common/Kconfig
```kconfig
menu "Common Configuration"
config WIFI_CHANNEL
    int "WiFi Channel"
    default 1
    range 1 11
    help
        Wi-Fi Channel to use for communication
config SIMULATE_PACKET_LOSS
    bool "Randomly drop outgoing packets"
    help
        Simulate packet loss by randomly dropping outgoing packets
config PACKET_LOSS_MOD
    int "Packet Loss Modulus"
    depends on SIMULATE_PACKET_LOSS
    default 10
    range 2 100
    help
        Packet is dropped if (rand % ???) == 0
endmenu
```

## node/main/Kconfig.projbuild
```kconfig
menu "Node Configuration"
config READ_BUF_SIZE
    int "Read Buffer Size"
    default 8192
    range 1024 16384
    help
    File read buffer size. Used by mtftp tatsk
config WRITE_BUF_SIZE
    int "Write Buffer Size"
    default 8192
    range 1024 16384
    help
    File write buffer size. Used by sample task
config SAMPLE_PERIOD
    int "Sample Period (us)"
    default 20000
    range 1000 1000000
    help
    Period of sensor sampling
config SAMPLE_BUFFER_NUM
    int "Number of samples to buffer"
    default 512
    range 1 32768
    help
    Two buffers will be allocated to each hold SAMPLE_BUFFER_NUM amount of samples
config START_WITHOUT_TIME_SYNC
    bool "Start sampling without waiting for time sync"
    help
        If set, sampling will start without waiting for a time sync
config BTN_SHUTDOWN_TIME
    int "Time that btn has to be pressed to shutdown node"
    default 3000000
    range 500000 10000000
endmenu
```

## node/sdkconfig.defaults
```kconfig
CONFIG_ESP32_ULP_COPROC_ENABLED=y

CONFIG_ESP32_SPIRAM_SUPPORT=y
CONFIG_SPIRAM_TYPE_AUTO=y
CONFIG_SPIRAM_SPEED_40M=y
CONFIG_SPIRAM=y
CONFIG_SPIRAM_BOOT_INIT=y
CONFIG_SPIRAM_USE_CAPS_ALLOC=y
```
